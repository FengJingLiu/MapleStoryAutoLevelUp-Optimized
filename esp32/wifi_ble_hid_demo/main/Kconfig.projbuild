## esp32/wifi_ble_hid_demo/main/Kconfig.projbuild
```kconfig
menu "USB Serial BLE HID Bridge"

    config HID_DEVICE_NAME
        string "Bluetooth HID device name"
        default "Maple-ESP32-Keyboard"

    config HID_LEASE_TIMEOUT_MS
        int "Client lease timeout (milliseconds)"
        range 1000 30000
        default 3000
        help
            All keys are released when no valid serial command arrives before this timeout.

    config HID_MAX_TAP_MS
        int "Maximum TAP duration (milliseconds)"
        range 10 5000
        default 1000

endmenu
```
